## software/linux/drivers/Kconfig
```kconfig
config ENDEAVOUR2_DRIVERS
	bool "Drivers for Endeavour2 SoC"
	depends on RISCV
	default y
	select SERIAL_CORE
	select SERIAL_CORE_CONSOLE
	select SERIAL_EARLYCON
	select SND_PCM
	select FB_IOMEM_HELPERS
	help
	  Drivers for Endeavour2 SoC.
```
